## firmware/esp32s3/mis01_fw/sdkconfig.defaults
```kconfig
CONFIG_IDF_TARGET="esp32s3"

# 模组 WROOM-1U-N16R8：16 MB Flash、8 MB Octal PSRAM
CONFIG_ESPTOOLPY_FLASHSIZE_16MB=y
CONFIG_ESPTOOLPY_FLASHMODE_QIO=y
CONFIG_SPIRAM=y
CONFIG_SPIRAM_MODE_OCT=y
CONFIG_PARTITION_TABLE_CUSTOM=y
CONFIG_PARTITION_TABLE_CUSTOM_FILENAME="partitions.csv"

CONFIG_FREERTOS_HZ=1000

# 日志只走 UART0（板载 CH343P），原生 USB 留给 TinyUSB CDC（协议口）
CONFIG_ESP_CONSOLE_UART_DEFAULT=y
CONFIG_ESP_CONSOLE_SECONDARY_NONE=y

# S2：任务看门狗 + 中断看门狗，触发即 panic 复位
CONFIG_ESP_INT_WDT=y
CONFIG_ESP_INT_WDT_TIMEOUT_MS=300
CONFIG_ESP_TASK_WDT_EN=y
CONFIG_ESP_TASK_WDT_INIT=y
CONFIG_ESP_TASK_WDT_PANIC=y
CONFIG_ESP_TASK_WDT_TIMEOUT_S=3
CONFIG_ESP_TASK_WDT_CHECK_IDLE_TASK_CPU0=y
CONFIG_ESP_TASK_WDT_CHECK_IDLE_TASK_CPU1=y
CONFIG_ESP_SYSTEM_PANIC_PRINT_REBOOT=y
CONFIG_ESP_BROWNOUT_DET=y

# IV-18 扫描在 GPTimer 中断里改闹钟
CONFIG_GPTIMER_ISR_HANDLER_IN_IRAM=y
CONFIG_GPTIMER_CTRL_FUNC_IN_IRAM=y

# TinyUSB CDC
CONFIG_TINYUSB_CDC_ENABLED=y
CONFIG_TINYUSB_CDC_COUNT=1
CONFIG_TINYUSB_CDC_RX_BUFSIZE=512
CONFIG_TINYUSB_CDC_TX_BUFSIZE=1024
CONFIG_TINYUSB_DESC_PRODUCT_STRING="MIS-01 Instrument"
CONFIG_TINYUSB_DESC_MANUFACTURER_STRING="MIS-01"

CONFIG_COMPILER_OPTIMIZATION_PERF=y
CONFIG_LWIP_SNTP_MAX_SERVERS=2
# 开机少等约 0.7 s（PSRAM 自检）；初版不用 PSRAM 存关键数据
CONFIG_SPIRAM_MEMTEST=n
```
